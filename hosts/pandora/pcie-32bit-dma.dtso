/*
 * DT overlay for fixing SATA drives connected to the on-board JMB585 SATA-PCIe
 * bridge not being found on Linux 6.18.24 or later on Raspberry Pi boards.
 *
 * The issue is addressed by dropping the DMA ranges down to 2 GB. Since
 * 6.18.24, JMB585 is forced into 32-bit DMA because 64-bit DMA is broken and
 * Raspberry Pi has issues with 32-bit DMA:
 * https://github.com/artmoty-dev/n5pro-jmb585-fix/tree/cf23df3b3606702b180e48ed8442b7e730dffb9b#whats-happening
 * https://github.com/raspberrypi/linux/issues/4848#issuecomment-1028191675
 *
 * This DT overlay is adapted from downstream:
 * https://github.com/raspberrypi/linux/blob/3a44d1cb497e2c28bdcbda21369111287be953db/arch/arm/boot/dts/overlays/pcie-32bit-dma-overlay.dts
 */

/dts-v1/;
/plugin/;

/ {
	compatible = "brcm,bcm2711";
};

&{/aliases} {
	/*
	 * Removing this alias stops the firmware from patching the PCIe DT
	 * dma-ranges based on the detected chip revision.
	 */
	pcie0 = "";
};

&pcie0 {
	/*
	 * The size of the range is rounded up to a power of 2, so the range
	 * ends up being 0-4 GB, and the MSI vector gets pushed beyond 4 GB.
	 */
	#address-cells = <3>;
	#size-cells = <2>;
	dma-ranges = <0x02000000 0x0 0x00000000 0x0 0x00000000 0x0 0x80000000>;
};
